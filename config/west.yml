## config/west.yml
```yaml
manifest:
  defaults:
    revision: v0.3
  remotes:
    - name: zmkfirmware
      url-base: https://github.com/zmkfirmware
    # Additional modules containing boards/shields/custom code can be listed here as well
    # See https://docs.zephyrproject.org/3.2.0/develop/west/manifest.html#projects
    - name: m165437 
      url-base: https://github.com/M165437 
    - name: gpeye                         #new entry
      url-base: https://github.com/GPeye  #new entry

  projects:
    - name: zmk
      remote: zmkfirmware
      import: app/west.yml
    - name: nice-view-gem
      remote: m165437
      revision: 7794ebf  # Pin to pre-Zephyr 4.1 version          
    - name: hammerbeam-slideshow          #new entry
      remote: gpeye                       #new entry
      revision: main                      #new entry               
  self:
    path: config
```
